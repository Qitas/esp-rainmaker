## examples/gpio/sdkconfig.defaults
```kconfig
CONFIG_IDF_TARGET="esp32c6"
CONFIG_ESPTOOLPY_FLASHSIZE_4MB=y
CONFIG_PARTITION_TABLE_SINGLE_APP=
CONFIG_PARTITION_TABLE_TWO_OTA=
CONFIG_PARTITION_TABLE_CUSTOM=y
CONFIG_PARTITION_TABLE_CUSTOM_FILENAME="partitions.csv"
CONFIG_PARTITION_TABLE_FILENAME="partitions.csv"
CONFIG_PARTITION_TABLE_OFFSET=0x8000
CONFIG_PARTITION_TABLE_MD5=y

# mbedtls
CONFIG_MBEDTLS_DYNAMIC_BUFFER=y
CONFIG_MBEDTLS_DYNAMIC_FREE_PEER_CERT=y
CONFIG_MBEDTLS_DYNAMIC_FREE_CONFIG_DATA=y
CONFIG_MBEDTLS_CERTIFICATE_BUNDLE_DEFAULT_CMN=y
CONFIG_MBEDTLS_TLS_CLIENT_ONLY=y

CONFIG_BT_ENABLED=n
CONFIG_BT_NIMBLE_ENABLED=n
CONFIG_BT_CONTROLLER_ENABLED=n

# Temporary Fix for Timer Overflows
CONFIG_FREERTOS_TIMER_TASK_STACK_DEPTH=3120

# For additional security on reset to factory
CONFIG_ESP_RMAKER_USER_ID_CHECK=y

# Secure Local Control
CONFIG_ESP_RMAKER_LOCAL_CTRL_ENABLE=y
CONFIG_ESP_RMAKER_LOCAL_CTRL_SECURITY_1=y

# Application Rollback
CONFIG_BOOTLOADER_APP_ROLLBACK_ENABLE=y

CONFIG_ESP_RMAKER_NO_CLAIM=y
CONFIG_ESP_RMAKER_CLAIM_TYPE=0

CONFIG_APP_WIFI_PROV_TRANSPORT_SOFTAP=y
CONFIG_APP_WIFI_PROV_TRANSPORT=1
CONFIG_WS2812_LED_ENABLE=y
CONFIG_WS2812_LED_GPIO=8
CONFIG_EXAMPLE_BOARD_BUTTON_GPIO=9
#
# FreeRTOS
#
CONFIG_FREERTOS_USE_TRACE_FACILITY=y
CONFIG_FREERTOS_USE_STATS_FORMATTING_FUNCTIONS=y
CONFIG_FREERTOS_VTASKLIST_INCLUDE_COREID=y
CONFIG_FREERTOS_GENERATE_RUN_TIME_STATS=y
CONFIG_FREERTOS_RUN_TIME_STATS_USING_ESP_TIMER=y
```

## examples/gpio/sdkconfig.defaults.esp32c2
```kconfig
CONFIG_IDF_TARGET="esp32c2"
CONFIG_ESPTOOLPY_FLASHSIZE_4MB=y
CONFIG_PARTITION_TABLE_SINGLE_APP=y
CONFIG_PARTITION_TABLE_CUSTOM=y
CONFIG_PARTITION_TABLE_CUSTOM_FILENAME="partitions.csv"
CONFIG_PARTITION_TABLE_FILENAME="partitions.csv"
CONFIG_PARTITION_TABLE_OFFSET=0x8000
CONFIG_PARTITION_TABLE_MD5=y
CONFIG_LWIP_IPV6=y

CONFIG_ESP_PHY_MAX_TX_POWER=20
CONFIG_EXAMPLE_MAX_CPU_FREQ_120=y

# Enable support for power management
CONFIG_PM_ENABLE=y
CONFIG_PM_DFS_INIT_AUTO=y
CONFIG_ESP_PHY_MAC_BB_PD=y
CONFIG_EXAMPLE_POWER_SAVE_MAX_MODEM=y
CONFIG_ESP_WIFI_STA_DISCONNECTED_PM_ENABLE=y

CONFIG_EXAMPLE_WIFI_LISTEN_INTERVAL=10
CONFIG_ESP_WIFI_SLP_DEFAULT_MIN_ACTIVE_TIME=10
CONFIG_ESP_WIFI_SLP_DEFAULT_MAX_ACTIVE_TIME=60

# Secure Local Control
CONFIG_ESP_RMAKER_LOCAL_CTRL_ENABLE=n

#
# Main XTAL Config
#
CONFIG_XTAL_FREQ_26=y
# CONFIG_XTAL_FREQ_40 is not set
CONFIG_XTAL_FREQ=26



#
# ESP RainMaker App Wi-Fi Provisioning
#
# CONFIG_APP_WIFI_PROV_SHOW_QR is not set
# CONFIG_APP_WIFI_PROV_TRANSPORT_SOFTAP is not set
CONFIG_APP_WIFI_PROV_TRANSPORT_BLE=y
CONFIG_APP_WIFI_PROV_TRANSPORT=2
CONFIG_APP_WIFI_RESET_PROV_ON_FAILURE=y
CONFIG_APP_WIFI_PROV_MAX_RETRY_CNT=5
# CONFIG_APP_WIFI_SHOW_DEMO_INTRO_TEXT is not set
CONFIG_APP_WIFI_PROV_TIMEOUT_PERIOD=30
CONFIG_APP_WIFI_PROV_NAME_PREFIX="PROV"
# end of ESP RainMaker App Wi-Fi Provisioning

# mbedtls
CONFIG_MBEDTLS_DYNAMIC_BUFFER=y
CONFIG_MBEDTLS_DYNAMIC_FREE_PEER_CERT=y
CONFIG_MBEDTLS_DYNAMIC_FREE_CONFIG_DATA=y
CONFIG_MBEDTLS_CERTIFICATE_BUNDLE_DEFAULT_CMN=y

# For BLE Provisioning using NimBLE stack (Not applicable for ESP32-S2)
CONFIG_BT_ENABLED=y
CONFIG_BTDM_CTRL_MODE_BLE_ONLY=y
CONFIG_BT_NIMBLE_ENABLED=y
CONFIG_BT_NIMBLE_SM_SC=y
CONFIG_BT_NIMBLE_SM_SC_DEBUG_KEYS=y
CONFIG_BT_NIMBLE_LL_CFG_FEAT_LE_ENCRYPTION=n
CONFIG_BT_NIMBLE_SM_LEGACY=n

# Temporary Fix for Timer Overflows
CONFIG_FREERTOS_TIMER_TASK_STACK_DEPTH=3120

# For additional security on reset to factory
CONFIG_ESP_RMAKER_USER_ID_CHECK=y

# Secure Local Control
CONFIG_ESP_RMAKER_LOCAL_CTRL_ENABLE=n

# Application Rollback
CONFIG_BOOTLOADER_APP_ROLLBACK_ENABLE=y

CONFIG_WIFI_PROV_BLE_BONDING=n
CONFIG_WIFI_PROV_BLE_SEC_CONN=n
CONFIG_WIFI_PROV_BLE_FORCE_ENCRYPTION=n
CONFIG_WIFI_PROV_KEEP_BLE_ON_AFTER_PROV=n
CONFIG_WIFI_PROV_DISCONNECT_AFTER_PROV=y
CONFIG_ESP_RMAKER_CMD_RESP_ENABLE=n


CONFIG_BT_BLE_BLUFI_ENABLE=y
# CONFIG_BT_GATTC_ENABLE is not set
# CONFIG_BT_BLE_SMP_ENABLE is not set
# CONFIG_BT_BLE_50_FEATURES_SUPPORTED is not set
CONFIG_BT_BLE_42_FEATURES_SUPPORTED=y
CONFIG_MBEDTLS_DHM_C=y


#
# SPI Flash driver
#
CONFIG_SPI_FLASH_ROM_DRIVER_PATCH=y
CONFIG_SPI_FLASH_ROM_IMPL=y

#
# Heap memory debugging
#
CONFIG_HEAP_ROM_IMPL=y
```
